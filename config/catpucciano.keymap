#include <behaviors.dtsi>
#include <behaviors/num_word.dtsi> // urob's auto-layer repo
#include <dt-bindings/zmk/keys.h>
#include <dt-bindings/zmk/bt.h>
#include <dt-bindings/zmk/outputs.h>


#include "zmk-helpers/helper.h" // urob's helper repo
#include "includes/catpucciano.h" // catpucciano key definiton


#define BASE  0
#define NAV   1
#define NUM   2
#define FN    3
#define SYS   4
#define MOUSE 5

#define XXX &none
#define ___ &trans


#define QUICK_TAP_MS 175

&lt {
    flavor= "balanced";
    tapping-term-ms=<200>;
    quick-tap-ms=<175>;
};


/* Homerow mods */

#define KEYS_L LT0 LT1 LT2 LT3 LM0 LM1 LM2 LM3 LM4 LB0 LB1 LB2 LB3 LB4
#define KEYS_R RT0 RT1 RT2 RT3 RM0 RM1 RM2 RM3 RM4 RB0 RB1 RB2 RB3 RB4
#define THUMBS LH2 LH1 LH0 RH0 RH1 RH2 


#define MAKE_HRM(NAME, HOLD, TAP, TRIGGER_POS)                                 \
  ZMK_HOLD_TAP(NAME, bindings = <HOLD>, <TAP>; flavor = "balanced";            \
               tapping-term-ms = <280>; quick-tap-ms = <QUICK_TAP_MS>;         \
               require-prior-idle-ms = <150>; hold-trigger-on-release;         \
               hold-trigger-key-positions = <TRIGGER_POS>;)


MAKE_HRM(hml, &kp, &kp, KEYS_R THUMBS) // Left-hand HRMs.
MAKE_HRM(hmr, &kp, &kp, KEYS_L THUMBS) // Right-hand HRMs.


/* Combos, mouse emulation */
#include "includes/combos.dtsi"
#include "includes/mouse.dtsi"
#include "includes/leader.dtsi"

// Trigger tap-action on all interrupts.
#define MT_CORE                                                                \
  flavor = "tap-preferred";                                                    \
  tapping-term-ms = <220>;                                                     \
  quick-tap-ms = <220>;                                                        \
  hold-trigger-key-positions = <0>;


&mt { MT_CORE };

/* Magic-shift & auto-layers */

// Tap: repeat after alpha, else sticky-shift |
// Shift + tap/ double-tap: caps-word | Hold: shift.

#define MAGIC_SHIFT &magic_shift LSHFT 0

ZMK_HOLD_TAP(magic_shift, bindings = <&kp>, <&magic_shift_tap>;
             flavor = "balanced"; tapping-term-ms = <200>;
             quick-tap-ms = <QUICK_TAP_MS>;)

ZMK_MOD_MORPH(magic_shift_tap, bindings = <&shift_repeat>, <&caps_word>;
              mods = <(MOD_LSFT)>;)

ZMK_ADAPTIVE_KEY(
    shift_repeat, bindings = <&sk LSHFT>;
    repeat {
      trigger-keys = <A B C D E F G H I J K L M N O P Q R S T U V W X Y Z>;
      bindings = <&key_repeat>;
      max-prior-idle-ms = <1200>;
      strict-modifiers;
    };)
&caps_word { // Mods deactivate caps-word, requires PR #1451. [TODO: rebase]
  /delete-property/ ignore-modifiers;
};

// Smart-mouse, requires tri-state module.
ZMK_TRI_STATE(
    smart_mouse, bindings = <&tog MOUSE>, <&none>, <&tog MOUSE>;
    ignored-key-positions =
        <LT1 LT2 LT3 LM0 LM1 LM2 LM3 LM4 LB1 LB2 LB3 LH0 LH1>;
    ignored-layers = <MOUSE NAV>;)

// Alt+Tab swapper, requires tri-state module.
ZMK_TRI_STATE(swapper, bindings = <&kt LALT>, <&kp TAB>, <&kt LALT>;
              ignored-key-positions = <LT2 LT1>;)


// Define mod-morph with a *single* mod trigger for less repetition.
#define SIMPLE_MORPH(NAME, MOD, BINDING1, BINDING2)                            \
ZMK_MOD_MORPH(NAME, mods = <(MOD_L##MOD | MOD_R##MOD)>;                      \
                bindings = <BINDING1>, <BINDING2>;)

// Tap: comma | Shift + tap: semicolon | Ctrl + shift + tap: <.
SIMPLE_MORPH(comma_morph, SFT, &kp COMMA, &comma_inner_morph)
SIMPLE_MORPH(comma_inner_morph, CTL, &kp SEMICOLON, &kp LESS_THAN)

// Tap: dot | Shift + tap: colon | Ctrl + shift + tap: >.
SIMPLE_MORPH(dot_morph, SFT, &kp DOT, &dot_inner_morph)
SIMPLE_MORPH(dot_inner_morph, CTL, &kp COLON, &kp GREATER_THAN)

// Tap: qmark | Shift + tap: excl.
SIMPLE_MORPH(qexcl, SFT, &kp QMARK, &kp EXCL)


// Misc aliases
#define CANCEL    &kp K_CANCEL            // Cancel caps-word & auto-layers.
#define NAV_BSPC  &mt LC(BSPC) BSPC  // Tap: bspc          | Long-tap: delete word bwd.
#define NAV_DEL   &mt LC(DEL)  DEL   // Tap: del           | Long-tap: delete word fwd.
#define NAV_START &mt LC(HOME) HOME  // Tap: Start of line | Long-tap: start of doc.
#define NAV_END   &mt LC(END)  END   // Tap: End of line   | Long-tap: end   of doc.

// DisplayFusion Ctrl + Shift + Alt
#define MEH0 &kp LC(LS(LA(N0)))
#define MEH1 &kp LC(LS(LA(N1)))
#define MEH2 &kp LC(LS(LA(N2)))
#define MEH3 &kp LC(LS(LA(N3)))
#define MEH4 &kp LC(LS(LA(N4)))
#define MEH5 &kp LC(LS(LA(N5)))
#define MEH6 &kp LC(LS(LA(N6)))
#define MEH7 &kp LC(LS(LA(N7)))
#define MEH8 &kp LC(LS(LA(N8)))
#define MEH9 &kp LC(LS(LA(N9)))

/* Keymap */

#ifndef ZMK_BASE_LAYER
  #define ZMK_BASE_LAYER(name, LT, RT, LM, RM, LB, RB, LH, RH)                 \
      ZMK_LAYER(name, LT RT LM RM LB RB LH RH)
#endif


ZMK_BASE_LAYER(Base,
//                              ╭──────────────┬──────────────┬──────────────┬──────────────╮╭──────────────┬──────────────┬──────────────┬──────────────╮
                                  &kp W          &kp L          &kp P          &kp B        ,  &kp Z          &kp J          &kp K          &qexcl       ,
//               ╭──────────────┼──────────────┼──────────────┼──────────────┼──────────────┤├──────────────┼──────────────┼──────────────┼──────────────┼──────────────╮  
                   &hml LGUI C    &hml LALT S    &hml LCTRL N   &hml LSHFT T   &kp G        ,  &comma_morph   &hmr RSHFT A   &hmr RCTRL E   &hmr RALT I    &hmr RGUI H  ,
//               ├──────────────┼──────────────┼──────────────┼──────────────┼──────────────┤├──────────────┼──────────────┼──────────────┼──────────────┼──────────────┤ 
                   &kp Q          &kp X          &kp M          &kp D          &kp V        ,  &dot_morph     &kp U          &kp O          &kp Y          &kp F        ,  
//               ╰──────────────┴──────────────┼──────────────┼──────────────┼──────────────┤├──────────────┼──────────────┼──────────────┼──────────────┴──────────────╯
                                                 &kp ESC        &lt FN R       &lt NUM BSPC ,  &lt NAV SPACE  MAGIC_SHIFT    &kp ENTER
//                                             ╰──────────────┴──────────────┴──────────────╯╰──────────────┴──────────────┴──────────────╯
)
ZMK_BASE_LAYER(Nav,  
//                              ╭──────────────┬──────────────┬──────────────┬──────────────╮╭──────────────┬──────────────┬──────────────┬──────────────╮
                                  ___            ___            ___            ___          ,  NAV_START     &kp PG_DN      &kp PG_UP       NAV_END     ,  
//               ╭──────────────┼──────────────┼──────────────┼──────────────┼──────────────┤├──────────────┼──────────────┼──────────────┼──────────────┼──────────────╮  
                   &sk LGUI       &sk LALT       &sk LSHFT      &sk LCTRL      ___          ,  &kp LEFT       &kp DOWN       &kp UP         &kp RIGHT      &kp ESC      ,
//               ├──────────────┼──────────────┼──────────────┼──────────────┼──────────────┤├──────────────┼──────────────┼──────────────┼──────────────┼──────────────┤ 
                   ___            ___            ___            ___            ___          ,  &kp UNDER      &kp MINUS      &kp FSLH       &kp BSLH       NAV_DEL      ,
//               ╰──────────────┴──────────────┴──────────────┼──────────────┼──────────────┤├──────────────┼──────────────┼──────────────┼──────────────┴──────────────╯
                                                 ___            CANCEL         &mo SYS      ,  XXX            ___            ___ 
//                                             ╰──────────────┴──────────────┴──────────────╯╰──────────────┴──────────────┴──────────────╯                                       
)

ZMK_BASE_LAYER(Num,
//                              ╭──────────────┬──────────────┬──────────────┬──────────────╮╭──────────────┬──────────────┬──────────────┬──────────────╮
                                  &kp LA(F4)     &kp LS(TAB)    &swapper       &kp F13      ,  ___            &kp C_NEXT     &kp C_PP       &kp C_PREV   ,  
               //╭──────────────┼──────────────┼──────────────┼──────────────┼──────────────┤├──────────────┼──────────────┼──────────────┼──────────────┼──────────────╮  
                   &kp N1         &kp N2         &kp N3         &kp N4         &kp N5       ,  ___            &kp C_VOL_UP   &kp C_VOL_DN   &kp C_MUTE     ___          ,
//               ├──────────────┼──────────────┼──────────────┼──────────────┼──────────────┤├──────────────┼──────────────┼──────────────┼──────────────┼──────────────┤ 
                   &kp N6         &kp N7         &kp N8         &kp N9         &kp N0       ,  ___            ___            ___            ___            ___          ,  
//               ╰──────────────┴──────────────┼──────────────┼──────────────┼──────────────┤├──────────────┼──────────────┼──────────────┼──────────────┴──────────────╯
                                                 ___            ___            XXX          ,  ___            ___            ___ 
//                                             ╰──────────────┴──────────────┴──────────────╯╰──────────────┴──────────────┴──────────────╯  
)
ZMK_BASE_LAYER(FN,
//                              ╭──────────────┬──────────────┬──────────────┬──────────────╮╭──────────────┬──────────────┬──────────────┬──────────────╮
                                  &kp C_MUTE     &kp C_VOL_DN   &kp C_VOL_UP   ___          ,  ___            &kp C_NEXT     &kp C_PP       &kp C_PREV   ,  
//               ╭──────────────┼──────────────┼──────────────┼──────────────┼──────────────┤├──────────────┼──────────────┼──────────────┼──────────────┼──────────────╮  
                   MEH1           MEH2           MEH3           MEH4           MEH5         ,  &kp F1         &kp F2         &kp F3         &kp F4         &kp F5       ,
//               ├──────────────┼──────────────┼──────────────┼──────────────┼──────────────┤├──────────────┼──────────────┼──────────────┼──────────────┼──────────────┤ 
                   MEH6           MEH7           MEH8           MEH9           MEH0         ,  &kp F6         &kp F7         &kp F8         &kp F9         &kp F10      ,
//               ╰──────────────┴──────────────┴──────────────┼──────────────┼──────────────┤├──────────────┼──────────────┼──────────────┼──────────────┴──────────────╯
                                                 ___            XXX            ___          ,  ___            &kp F11        &kp F12           
//                                             ╰──────────────┴──────────────┴──────────────╯╰──────────────┴──────────────┴──────────────╯                                       
)
ZMK_BASE_LAYER(Sys,
//                              ╭──────────────┬──────────────┬──────────────┬──────────────╮╭──────────────┬──────────────┬──────────────┬──────────────╮
                                  ___            ___            ___            &bootloader  ,  &bootloader    ___            ___            &bt BT_CLR   ,
//               ╭──────────────┼──────────────┼──────────────┼──────────────┼──────────────┤├──────────────┼──────────────┼──────────────┼──────────────┼──────────────╮  
                   &bt BT_SEL 4   &bt BT_SEL 3   &bt BT_SEL 2   &bt BT_SEL 1   &bt BT_SEL 0 ,  ___            ___            ___            ___            ___          ,
//               ├──────────────┼──────────────┼──────────────┼──────────────┼──────────────┤├──────────────┼──────────────┼──────────────┼──────────────┼──────────────┤
                   ___            ___            ___            ___            ___          ,  ___            ___            ___            ___            ___          ,
//               ╰──────────────┴──────────────┴──────────────┼──────────────┼──────────────┤├──────────────┼──────────────┼──────────────┼──────────────┼──────────────╯
                                                 ___            ___            XXX          ,  XXX            ___            ___
//                                             ╰──────────────┴──────────────┴──────────────╯╰──────────────┴──────────────┴──────────────╯
)

ZMK_BASE_LAYER(Mouse,
//                              ╭──────────────┬──────────────┬──────────────┬──────────────╮╭──────────────┬──────────────┬──────────────┬──────────────╮
                                  &kp PG_DN      MS_UP          &kp PG_UP      ___          ,  ___            ___            ___            ___          ,  
//               ╭──────────────┼──────────────┼──────────────┼──────────────┼──────────────┤├──────────────┼──────────────┼──────────────┼──────────────┼──────────────╮  
                   MS_SCRL        MS_LEFT        MS_DOWN        MS_RIGHT       MS_SCRR      ,  ___            ___            ___            ___            ___          ,
//               ├──────────────┼──────────────┼──────────────┼──────────────┼──────────────┤├──────────────┼──────────────┼──────────────┼──────────────┼──────────────┤ 
                   ___            MS_SCRD        ___            MS_SCRU        ___          ,  ___            ___            ___            ___            ___          , 
//               ╰──────────────┴──────────────┼──────────────┼──────────────┼──────────────┤├──────────────┼──────────────┼──────────────┼──────────────┴──────────────╯
                                                 &mkp RCLK      &mkp MCLK      &mkp LCLK    ,  ___            ___            ___
//                                             ╰──────────────┴──────────────┴──────────────╯╰──────────────┴──────────────┴──────────────╯
)

