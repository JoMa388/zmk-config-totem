// Requires Tri- State Layer repo
// Alt+Tab swapper
/ {
    behaviors {
        swapper: swapper {
            compatible = "zmk,behavior-tri-state";
            #binding-cells = <0>;
            bindings = <&kt LALT>, <&kp TAB>, <&kt LALT>;
            ignored-key-positions= <2 28 29 10>;
        };
        smart_mouse: smart_mouse {
            compatible = "zmk,behavior-tri-state";
            #binding-cells = <0>;
            bindings = <&tog MOUSE>, <&none>, <&tog MOUSE>;
            ignored-key-positions= <0 1 2 8 9 10 11 12 19 21 28 29 30>;
            ignored-layers =<MOUSE NAV>;
        };
    };
}; 