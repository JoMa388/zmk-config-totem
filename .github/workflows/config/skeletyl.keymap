#include <behaviors.dtsi>
#include <dt-bindings/zmk/keys.h>
#include <dt-bindings/zmk/bt.h>

#define BASE 0

    keymap {
        compatible = "zmk,keymap";

        // Layer nodes go here!

        base_layer {
            label = "BASE";
            binding = <
            &kp ESC   &kp Q &kp W &kp F &kp P &kp B                   &kp J &kp L &kp U &kp Y &kp SEMI &kp BACKSLASH
            &kp LCTRL &kp A &kp R &kp S &kp T &kp G                   &kp M &kp N &kp E &kp I &kp O &kp SQT
            &kp TAB   &kp Z &kp X &kp C &kp D &kp V                   &kp K &kp H &kp COMMA &kp DOT &kp SLASH &kp BACKSLASH
                                  &kp F &kp P &kp B                   &kp J &kp L &kp U 
            >;
        }
    };